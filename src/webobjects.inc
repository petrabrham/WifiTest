const char bulb_on_gif[] PROGMEM = {0x47, 0x49, 0x46, 0x38, 0x39, 0x61, 0x64, 0x00, 0xB4, 0x00, 
0xD5, 0xFF, 0x00, 0xC0, 0xC0, 0xC0, 0xFF, 0xFF, 0xCC, 0xFF, 0xFF, 0x99, 0xFF, 0xFF, 0x66, 0xFF, 
0xFF, 0x33, 0xFF, 0xFF, 0x00, 0xFF, 0xCC, 0xFF, 0xFF, 0xCC, 0xCC, 0xFF, 0xCC, 0x99, 0xFF, 0xCC, 
0x66, 0xFF, 0xCC, 0x33, 0xFF, 0x99, 0x99, 0xFF, 0x99, 0x66, 0xFF, 0x99, 0x33, 0xCC, 0xFF, 0xFF, 
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0x3E, 0x50, 0x02, 0x11, 0x98, 0x40, 0x04, 0x5A, 0x47, 0x41, 0x95, 0x65, 0x14, 0x04, 0x00, 0x3B};

// convert by https://tomeko.net/online_tools/file_to_hex.php?lang=en
const char avatar_jpg[] PROGMEM = {0xFF, 0xD8, 0xFF, 0xE0, 0x00, 0x10, 0x4A, 0x46, 0x49, 0x46, 0x00, 0x01, 0x01, 0x01, 0x01, 0x2C, 
0x01, 0x2C, 0x00, 0x00, 0xFF, 0xDB, 0x00, 0x43, 0x00, 0x2F, 0x20, 0x23, 0x29, 0x23, 0x1D, 0x2F, 
0x29, 0x26, 0x29, 0x35, 0x32, 0x2F, 0x38, 0x47, 0x76, 0x4C, 0x47, 0x41, 0x41, 0x47, 0x90, 0x67, 
0x6D, 0x55, 0x76, 0xAB, 0x96, 0xB3, 0xB0, 0xA8, 0x96, 0xA5, 0xA2, 0xBC, 0xD4, 0xFF, 0xE5, 0xBC, 
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0x00, 0x5B, 0xD1, 0x55, 0x4F, 0xEB, 0x90, 0x00, 0x44, 0x26, 0xEC, 0x00, 0x03, 0xFF, 0xD9};
